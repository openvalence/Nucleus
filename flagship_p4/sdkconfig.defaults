## flagship_p4/src/Kconfig.projbuild
```kconfig
menu "Nucleus"

config NUCLEUS_BENCH_QUAD_LP10_12
    bool "Bench only: quadrature on LPG10/LPG12 instead of LPG3/LPG5"
    default n
    help
        Duct-tape bench (operator 2026-10-03): QUAD_A moves to LPG10 and
        QUAD_B to LPG12 so the devkit can splice into the old PCB. Those two
        pads are the accessory header IO2/IO1 on the flagship, so both are
        marked absent under this option. Never on in a release build; the
        flagship_p4_bench env sets it through bench.sdkconfig.defaults.

config NUCLEUS_BOARD_BARNACLE
    bool "Board: the barnacle (Stamp-P4 on the OSSM R+D board rev 2.3)"
    default n
    help
        nucleus-p4b. Quadrature A on LPG1 and B on LPG0 at drive strength 3,
        TRIP on LPG8 as the home sense and the running stop, and the WROOM-32D
        helper on a UART (TX G27, RX G26) for the button, motor current, motor
        voltage and the status pixel. No Flagship monitors, motor switch,
        E-stop input or Modbus link: the board I/O doors link the barnacle
        hosts (system/BarnacleLink.h). The flagship_p4_barnacle env sets it
        through barnacle.sdkconfig.defaults. Never on in a Flagship image.

config NUCLEUS_DRIVE_LINK
    bool "RS485 Modbus link to the drive"
    default y
    help
        The drive link (system/ValenceDriveLink.cpp): the post-enable probe of
        the drive's identity and configuration, and the alarm-code and encoder
        poll. architecture.md section 1: the Modbus bus is for configuration
        and the encoder audit only, and a production build may omit it. Off,
        the UART is never installed, RS485_DE stays a GPIO held low, DRV_ALM
        and DRV_RDY are still watched and still latch ESTOP, and the
        self-check's drive-link row reads SKIPPED.

endmenu
```
